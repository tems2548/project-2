#include <Adafruit_GFX.h>
#include <Adafruit_SH110X.h>
#include <Wire.h>
#include "RTClib.h"
#include <MechaQMC5883.h>
#include <Adafruit_AHTX0.h>
#include <Adafruit_BMP280.h>
#include <Grove_LED_Bar.h>
#include <Fonts/FreeSansBoldOblique12pt7b.h>
#include <Fonts/FreeSerifItalic9pt7b.h>
#include <Fonts/FreeSans9pt7b.h>
#include <Fonts/FreeSans18pt7b.h>
#include <Fonts/FreeMonoOblique12pt7b.h>
#include <Fonts/FreeMono24pt7b.h>
#include <Fonts/FreeSansBold9pt7b.h>
#include <Fonts/FreeSansBold18pt7b.h>
#include <Fonts/FreeSerifItalic18pt7b.h>
#include <Fonts/FreeMono12pt7b.h>
#include "PMS.h"
#include "Adafruit_CCS811.h"
#include <Multichannel_Gas_GMXXX.h>

#define REPORTING_PERIOD_MS     1100
#define SCREEN_WIDTH 128 
#define SCREEN_HEIGHT 64 
#define OLED_RESET -1   
#define i2c_Address 0x3c
#define buttonPin D6
#define buzzerpin D3
#define LED D0


unsigned long last_time = 0;
unsigned long period = 1000;
unsigned long period2 = 5000;
const int centreX = 65;
const int centreY = 30;
const int radius  = 30; 
int SW = 0;
int SW2 = 0;
int state = 0;
int TP1;
int TP2;
int32_t spo2;
int last_dx, last_dy, dx, dy, angle;
static uint8_t recv_cmd[8] = {};
char daysOfTheWeek[7][12] = {"Sunday", "Monday", "Tuesday", "Wednesday", "Thursday", "Friday", "Saturday"};

Grove_LED_Bar bar(D7, D8, 0, LED_BAR_10);
PMS pms(Serial);
PMS::DATA data;
MechaQMC5883 qmc;
Adafruit_SH1106G display = Adafruit_SH1106G(SCREEN_WIDTH, SCREEN_HEIGHT, &Wire, OLED_RESET);
RTC_DS3231 rtc;
Adafruit_AHTX0 aht;
Adafruit_BMP280 bmp;
Adafruit_CCS811 ccs;
GAS_GMXXX<TwoWire> gas;
Adafruit_Sensor *bmp_temp = bmp.getTemperatureSensor();
Adafruit_Sensor *bmp_pressure = bmp.getPressureSensor();

 // Can change Image by go to this link https://javl.github.io/image2cpp/

static const unsigned char PROGMEM logo2_bmp[] =
{ 0x03, 0xC0, 0xF0, 0x06, 0x71, 0x8C, 0x0C, 0x1B, 0x06, 0x18, 0x0E, 0x02, 0x10, 0x0C, 0x03, 0x10,              //Logo2 and Logo3 are two bmp pictures that display on the OLED if called
0x04, 0x01, 0x10, 0x04, 0x01, 0x10, 0x40, 0x01, 0x10, 0x40, 0x01, 0x10, 0xC0, 0x03, 0x08, 0x88,
0x02, 0x08, 0xB8, 0x04, 0xFF, 0x37, 0x08, 0x01, 0x30, 0x18, 0x01, 0x90, 0x30, 0x00, 0xC0, 0x60,
0x00, 0x60, 0xC0, 0x00, 0x31, 0x80, 0x00, 0x1B, 0x00, 0x00, 0x0E, 0x00, 0x00, 0x04, 0x00,  };

static const unsigned char PROGMEM logo3_bmp[] =
{ 0x01, 0xF0, 0x0F, 0x80, 0x06, 0x1C, 0x38, 0x60, 0x18, 0x06, 0x60, 0x18, 0x10, 0x01, 0x80, 0x08,
0x20, 0x01, 0x80, 0x04, 0x40, 0x00, 0x00, 0x02, 0x40, 0x00, 0x00, 0x02, 0xC0, 0x00, 0x08, 0x03,
0x80, 0x00, 0x08, 0x01, 0x80, 0x00, 0x18, 0x01, 0x80, 0x00, 0x1C, 0x01, 0x80, 0x00, 0x14, 0x00,
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0x00, 0x08, 0x10, 0x00, 0x00, 0x06, 0x60, 0x00, 0x00, 0x03, 0xC0, 0x00, 0x00, 0x01, 0x80, 0x00  };

const unsigned char ICON [] PROGMEM = {
0x00, 0x00, 0x00, 0x00, 0x00, 0x00, 0x00, 0x00, 0x00, 0x00, 0x00, 0x00, 0x00, 0x00, 0x00, 0x00, 
	0x00, 0x00, 0x00, 0x00, 0x00, 0x00, 0x00, 0x00, 0x00, 0x00, 0x00, 0x00, 0x00, 0x00, 0x00, 0x00, 
	0x00, 0x00, 0x00, 0x00, 0x00, 0x00, 0x00, 0x00, 0x00, 0x00, 0x00, 0x00, 0x00, 0x00, 0x00, 0x00, 
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	0x00, 0x00, 0x00, 0x00, 0x00, 0x00, 0x00, 0x00, 0x00, 0x00, 0x00, 0x00, 0x00, 0x00, 0x00, 0x00
};
const unsigned char Open2 [] PROGMEM = {
	0x00, 0x00, 0x00, 0x00, 0x00, 0x00, 0x00, 0x00, 0x00, 0x00, 0x00, 0x00, 0x00, 0x00, 0x00, 0x00, 
	0x00, 0x00, 0x00, 0x00, 0x00, 0x00, 0x00, 0x00, 0x00, 0x00, 0x00, 0x00, 0x00, 0x00, 0x00, 0x00, 
	0x00, 0x00, 0x00, 0x00, 0x00, 0x00, 0x00, 0x00, 0x00, 0x00, 0x00, 0x00, 0x00, 0x00, 0x00, 0x00, 
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	0x00, 0x00, 0x00, 0x00, 0x00, 0x00, 0x00, 0x00, 0x00, 0x00, 0x00, 0x00, 0x00, 0x00, 0x00, 0x00
};

const unsigned char logo1 [] PROGMEM = {
	0x00, 0x00, 0x00, 0x00, 0x00, 0x00, 0x00, 0x00, 0x00, 0x00, 0x00, 0x00, 0x00, 0x00, 0x00, 0x00, 
	0x00, 0x00, 0x00, 0x00, 0x00, 0x00, 0x00, 0x00, 0x00, 0x00, 0x00, 0x00, 0x00, 0x00, 0x00, 0x01, 
	0x00, 0x00, 0x00, 0x00, 0x00, 0x00, 0x3f, 0xf0, 0x00, 0x00, 0x00, 0x00, 0x00, 0xff, 0xfc, 0x00, 
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	0x00, 0x00, 0x00, 0x00, 0x00, 0x00, 0x00, 0x00
};

const unsigned char logo2 [] PROGMEM = {
0x00, 0x00, 0x00, 0x00, 0x00, 0x00, 0x00, 0x00, 0x00, 0x00, 0x00, 0x00, 0x00, 0x00, 0x00, 0x00, 
	0x00, 0x00, 0x00, 0x00, 0x00, 0x00, 0x00, 0x00, 0x00, 0x00, 0x00, 0x00, 0x00, 0x00, 0x00, 0x01, 
	0x00, 0x00, 0x00, 0x00, 0x00, 0x00, 0x07, 0xe0, 0x00, 0x00, 0x00, 0x00, 0x00, 0x1e, 0xf0, 0x00, 
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	0x00, 0x00, 0x00, 0x00, 0x00, 0x00, 0x00, 0x00
};
const unsigned char logo3 [] PROGMEM = {
		0x00, 0x00, 0x00, 0x00, 0x00, 0x00, 0x00, 0x00, 0x00, 0x00, 0x00, 0x00, 0x00, 0x00, 0x00, 0x00, 
	0x00, 0x66, 0x00, 0x00, 0x00, 0x00, 0x00, 0x00, 0x76, 0x00, 0x00, 0x00, 0x00, 0x00, 0x00, 0x76, 
	0x00, 0x00, 0x00, 0x00, 0x00, 0x06, 0x7e, 0x40, 0x00, 0x00, 0x00, 0x00, 0x3e, 0x5e, 0x78, 0x00, 
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	0x00, 0x00, 0x00, 0x00, 0x00, 0x00, 0x00, 0x00
};

const unsigned char logo4 [] PROGMEM = {
	0x00, 0x00, 0x00, 0x00, 0x00, 0x00, 0x00, 0x00, 0x03, 0x80, 0x00, 0x00, 0x00, 0x00, 0x00, 0x07, 
	0xe0, 0x00, 0x00, 0x00, 0x00, 0x00, 0x0c, 0x60, 0x00, 0x00, 0x00, 0x00, 0x00, 0x0c, 0x30, 0x07, 
	0x07, 0x80, 0x00, 0x00, 0x08, 0x30, 0x0f, 0x87, 0x80, 0x00, 0x00, 0x08, 0x30, 0x02, 0x03, 0x00, 
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	0xe0, 0x00, 0x00, 0x00, 0x00, 0x00, 0x00, 0xc0
};
const unsigned char READY [] PROGMEM = {
	0x00, 0x00, 0x00, 0x00, 0x00, 0x00, 0x00, 0x00, 0x00, 0x00, 0x00, 0x00, 0x00, 0x00, 0x00, 0x00, 
	0x00, 0x00, 0x00, 0x00, 0x00, 0x00, 0x00, 0x00, 0x00, 0x00, 0x00, 0x00, 0x00, 0x00, 0x00, 0x00, 
	0x00, 0x00, 0x00, 0x00, 0x00, 0x00, 0x00, 0x00, 0x00, 0x00, 0x00, 0x00, 0x00, 0x00, 0x00, 0x00, 
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	0x00, 0x00, 0x00, 0x00, 0x00, 0x00, 0x00, 0x00, 0x00, 0x00, 0x00, 0x00, 0x00, 0x00, 0x00, 0x00
};

void setup() {
  Serial.begin(9600);
  pinMode(LED, OUTPUT);
  ccs.begin();
  Wire.begin();
  qmc.init();
  rtc.begin();
  aht.begin();
  bmp.begin();
  bar.begin();
  gas.begin(Wire, 0x08);
  // pox.setOnBeatDetectedCallback(onBeatDetected);
  bmp.setSampling(Adafruit_BMP280::MODE_NORMAL,     /* Operating Mode. */
                  Adafruit_BMP280::SAMPLING_X2,     /* Temp. oversampling */
                  Adafruit_BMP280::SAMPLING_X16,    /* Pressure oversampling */
                  Adafruit_BMP280::FILTER_X16,      /* Filtering. */
                  Adafruit_BMP280::STANDBY_MS_500); /* Standby time. */
  bmp_temp->printSensorDetails();
  // rtc.adjust(DateTime(__DATE__, __TIME__));
  delay(250); 
  display.begin(i2c_Address, true); 
  display.display();
  delay(2000);
  display.clearDisplay();
  display.setTextColor(SH110X_WHITE);
  display.setTextSize(2);
  display.setCursor(10,20);
  display.drawBitmap(0,0,ICON,128,64,SH110X_WHITE);
  // display.print("  TEST  ");
  display.cp437(true);
  display.display();
  delay(2000);
  display.clearDisplay();
  display.drawBitmap(0,0,Open2,128,64,SH110X_WHITE);
  display.display();
  delay(2000);
  display.clearDisplay();
  display.drawBitmap(0,0,READY,128,64,SH110X_WHITE);
  display.display();
  delay(2000);
  display.clearDisplay();
  pinMode(buttonPin, INPUT);
  pinMode(D5,INPUT);
  pinMode(buzzerpin,OUTPUT);
  digitalWrite(buzzerpin,1);
  delay(300);
  digitalWrite(buzzerpin,0);
  last_dx = centreX;
  last_dy = centreY;
  int T,E,S;
  qmc.read(&T,&E,&S);
}

void loop() {
 display.clearDisplay();
 TP2 = digitalRead(buttonPin); 
 TP1 = digitalRead(D5);
display.setTextSize(1);
display.setCursor(15, 5);
display.setTextColor(SH110X_WHITE);
display.print("Other Gas");
display.setCursor(15, 21);
display.print("COMPASS");
display.setCursor(15, 37);
display.print("T&H&P");
display.setCursor(15, 52);
display.print("AQI");
display.drawRect(0,0,128, 64, SH110X_WHITE);
bar.setGreenToRed(0);
if(TP2 == 1){
  delay(500);
  
  SW2++;
   if (SW2 > 1){
     
     SW2 = 0;
 }
}
// if (SW == 0 || SW == 1 || SW == 2 || SW == 3 && SW2 == 1 && TP2 == 1){
//   SW2 == 0;
// }

if(SW == 0){
  display.setTextSize(2);
  display.setTextColor(SH110X_WHITE);
  display.setCursor(0, 0);
  display.print(">");
  display.drawBitmap(65,5,logo2,56,56,SH110X_WHITE);
  while(SW2 == 1){
  Other_Gas();
  if(digitalRead(D5) == 1){
  SW2 = 0;
}
}
 
}

if(SW == 1){
  display.setTextSize(2);
  display.setTextColor(SH110X_WHITE);
  display.setCursor(0, 16);
  display.drawBitmap(65,5,logo3,56,56,SH110X_WHITE);
  display.print(">");
  while(SW2 == 1){
  Compass();
  if(digitalRead(D5) == 1){
  SW2 = 0;
}
}
}
if(SW == 2){
  display.setTextSize(2);
  display.setTextColor(SH110X_WHITE);
  display.setCursor(0, 32);
  display.drawBitmap(65,5,logo4,56,56,SH110X_WHITE);
  display.print(">");
  while(SW2 == 1){
  TeHuP();
  if(digitalRead(D5) == 1){
  SW2 = 0;
}
}

}
if(SW == 3){
  display.setTextSize(2);
  display.setTextColor(SH110X_WHITE);
  display.drawBitmap(65,5,logo1,56,56,SH110X_WHITE);
  display.setCursor(0, 47);
  display.print(">");
    while(SW2 == 1){
    Particle();

  if(digitalRead(D5) == 1){
  SW2 = 0;
}
}
}

if(TP1 == 1){
  delay(500);
  SW++;
      for (int i = 0; i <= 10; i++) {
        bar.setLevel(i);
        delay(50);
    }
    digitalWrite(buzzerpin,1);
    digitalWrite(LED,1);
    delay(60);
    digitalWrite(buzzerpin,0);
    digitalWrite(LED,0);
   if (SW > 3){
     SW = 0;
 }
}
display.display();
}

void Particle(){
  int pm1 = data.PM_AE_UG_1_0;
  int pm2 = data.PM_AE_UG_2_5;
  int pm3 = data.PM_AE_UG_10_0;
  int TVOC = ccs.getTVOC();
  int CO2 = ccs.geteCO2();
  bar.setGreenToRed(1);
  int map_bar = map(pm2,0,100,0,10);
  bar.setLevel(map_bar);

  display.clearDisplay();
  if(pms.read(data))
  {
    digitalWrite(LED,1);
    display.clearDisplay();
    display.setTextSize(1);
    display.setTextColor(SH110X_WHITE);
    display.setCursor(0,0);
    display.print("PM 1.0");
    display.setCursor(0,10);
    display.print("PM 2.5");
    display.setCursor(0,20);
    display.print("PM 10");
    display.setCursor(0,30);
    display.print("CO2");
    display.setCursor(0,40);
    display.print("TVOC");
    display.setCursor(60,0);
    display.print(data.PM_AE_UG_1_0);
    display.setCursor(90,0);
    display.print("ug/m3");
    display.setCursor(60,10);
    display.print(data.PM_AE_UG_2_5);
    display.setCursor(90,10);
    display.print("ug/m3");
    display.setCursor(60,20);
    display.print(data.PM_AE_UG_10_0);
    display.setCursor(90,20);
    display.print("ug/m3");

    ccs.readData();
    display.setTextSize(1);
    display.setTextColor(SH110X_WHITE);
    display.setCursor(60,30);
    display.print(CO2);
    display.setCursor(90,30);
    display.print("PPM");
    display.setCursor(60,40);
    display.print(TVOC);
    display.setCursor(90,40);
    display.print("PPB");
    
    Serial.println();
    display.display();

    if(pm2 <= 37){
        display.setTextSize(1);
        display.setTextColor(SH110X_WHITE);
        display.setCursor(0,52);
        display.print(">Good air quality");
        display.display();
        // int AQI = 
    }
    if(pm2 >= 38 && pm2 <= 50){
        display.setTextSize(1);
        display.setTextColor(SH110X_WHITE);
        display.setCursor(0,52);
        display.print(">Medium air quality");
        display.display();
    }
    if( pm2 >= 51 && pm2 <= 89){
        display.setTextSize(1);
        display.setTextColor(SH110X_WHITE);
        display.setCursor(0,52);
        display.print(">Bad air quality");
        display.display();
    }
    if(pm2 >= 90 ){
        display.setTextSize(1);
        display.setTextColor(SH110X_WHITE);
        display.setCursor(0,52);
        display.print(">HAZARD!!! ");
        display.display();
    }
    digitalWrite(LED,0);
  }
}

void Other_Gas() {
  if( millis() - last_time > period) {
    last_time = millis();
    display.clearDisplay();
    digitalWrite(LED,1);
    uint8_t len = 0;
    uint8_t addr = 0;
    uint8_t i;
    uint32_t NO2 = 0;
    uint32_t C2H5CH = 0;
    uint32_t VOC = 0;
    uint32_t CO  = 0;

    NO2 = gas.getGM102B();
    C2H5CH = gas.getGM302B();
    VOC = gas.getGM502B();
    CO = gas.getGM702B();

   display.setTextSize(1);
   display.setTextColor(SH110X_WHITE);
   display.setCursor(0,5);
   display.print("NO2");   
   display.setCursor(60,5);
   display.print(NO2);
   display.setCursor(90,5);
   display.print("PPM");

   display.setCursor(0,20);
   display.print("C2H5CH");
   display.setCursor(60,20);
   display.print(C2H5CH);
   display.setCursor(90,20);
   display.print("PPM");

   display.setCursor(0,35);
   display.print("VOC");
   display.setCursor(60,35);
   display.print(VOC);
   display.setCursor(90,35);
   display.print("PPM");

   display.setCursor(0,50);
   display.print("CO");
   display.setCursor(60,50);
   display.print(CO);
   display.setCursor(90,50);
   display.print("PPM");
   display.display(); 
   digitalWrite(LED,0);
 }
}

void Compass(){
  display.clearDisplay();
  int x,y,z; 
  qmc.read(&x,&y,&z); 
  Draw_Compass_Rose(); 
  float heading = atan2(y, x); 
  float declination = 0.041;
  heading = heading + declination;
  if(heading < 0)    heading += 2*PI;  
  if(heading > 2*PI) heading -= 2*PI; 
  angle = int(heading * 180/M_PI); 
  dx = (0.7*radius * cos((angle-90)*3.14/180)) + centreX;  
  dy = (0.7*radius * sin((angle-90)*3.14/180)) + centreY;  
  arrow(last_dx,last_dy, centreX, centreY, 2,2,SH110X_BLACK);        
  arrow(dx,dy, centreX, centreY, 2, 2,SH110X_WHITE);               
  last_dx = dx; 
  last_dy = dy;
  display.setCursor(0,38);
  display.fillRect(0,38,25,48,SH110X_BLACK);
  display.print(angle);
  display.print(char(176)); 
  display.display();
  delay(100);
}

void display_item(int x, int y, String token, int txt_colour, int txt_size) {
  display.setCursor(x, y);
  display.setTextColor(txt_colour);
  display.setTextSize(txt_size);
  display.print(token);
  display.setTextSize(1); // Back to default text size
}

void arrow(int x2, int y2, int x1, int y1, int alength, int awidth, int colour) {
  float distance;
  int dx, dy, x2o,y2o,x3,y3,x4,y4,k;
  distance = sqrt(pow((x1 - x2),2) + pow((y1 - y2), 2));
  dx = x2 + (x1 - x2) * alength / distance;
  dy = y2 + (y1 - y2) * alength / distance;
  k = awidth / alength;
  x2o = x2 - dx;
  y2o = dy - y2;
  x3 = y2o * k + dx;
  y3 = x2o * k + dy;
  x4 = dx - y2o * k;
  y4 = dy - x2o * k;
  display.drawLine(x1, y1, x2, y2, colour);
  display.drawLine(x1, y1, dx, dy, colour);
  display.drawLine(x3, y3, x4, y4, colour);
  display.drawLine(x3, y3, x2, y2, colour);
  display.drawLine(x2, y2, x4, y4, colour);
} 

void Draw_Compass_Rose() {
  int dxo, dyo, dxi, dyi;
  display.drawCircle(centreX,centreY,radius,SH110X_WHITE);  // Draw compass circle
  for (float i = 0; i <360; i = i + 22.5) {
    dxo = radius * cos(i*3.14/180);
    dyo = radius * sin(i*3.14/180);
    dxi = dxo * 0.95;
    dyi = dyo * 0.95;
    display.drawLine(dxi+centreX,dyi+centreY,dxo+centreX,dyo+centreY,SH110X_WHITE);   
  }
  display_item((centreX-2),(centreY-24),"N",SH110X_WHITE,1);
  display_item((centreX-2),(centreY+17),"S",SH110X_WHITE,1);
  display_item((centreX+19),(centreY-3),"E",SH110X_WHITE,1);
  display_item((centreX-23),(centreY-3),"W",SH110X_WHITE,1);
}
void TeHuP(){
  if(millis() - last_time > period) {
  last_time = millis();
  display.clearDisplay();
  sensors_event_t temp_event, pressure_event;
  bmp_temp->getEvent(&temp_event);
  bmp_pressure->getEvent(&pressure_event);
  display.setTextColor(SH110X_WHITE);
  display.setTextSize(1);
  sensors_event_t humidity, temp;
  aht.getEvent(&humidity, &temp);// populate temp and humidity objects with fresh data
  display.setCursor(0,0);
  display.print("Temperature: "); display.print(temp.temperature); display.print(" *C");
  display.print("Humidity: "); display.print(humidity.relative_humidity); display.println("% rH");
  display.print("Pressure: "); display.print(pressure_event.pressure); display.println(" hPa");
  int dispP = map(pressure_event.pressure,300,1100,0,100);
  display.setCursor(0,25);
  display.print("T");
  display.setCursor(0,36);
  display.print("H");
  display.setCursor(0,47);
  display.print("P");
  display.setCursor(105,56);
  display.print("100");
  display.drawLine(6,25,6,60,SH110X_WHITE);
  display.drawRect(6, 25, temp.temperature, 10, SH110X_WHITE);
  display.drawRect(6,36 , humidity.relative_humidity, 10, SH110X_WHITE);
  display.drawRect(6,47 , dispP, 10, SH110X_WHITE);
  display.drawLine(6,60,100,60,SH110X_WHITE);
  display.display();
  }
}
